## Kconfig
```kconfig
config USR_DRV_DRVISO7816
  bool  "userspace smartcard driver abstraction, using libusart"
  default y
  select USR_DRV_USART
  ---help---
  Support for USART-based SmartCard compatible with ISO7816
  interface.
```
